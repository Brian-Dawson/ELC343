# CY8C5868AXI_LP035 register map
File version: 0.1
CY8C58LP
Registers are 8-bit, read-write, no defined reset value unless marked. A register's access mark holds for its fields unless they carry their own. Offsets are from the block's base; lines under a group give offsets from that group; [hi:lo] are bit positions; {n}, {i} and the like mark numbered series; 'fields as' and 'values as' point back to an identical list; <NAME> marks a mode.

## Memory map
0x00000000 LED_Driver_1_Com_Driver
0x00000000 LED_Driver_1_Seg_Driver_L

## LED_Driver_1_Com_Driver
Base 0x00000000
0x40006575 LED_Driver_1_Com_Driver_CONTROL_REG

## LED_Driver_1_Seg_Driver_L
Base 0x00000000
0x40006574 LED_Driver_1_Seg_Driver_L_CONTROL_REG
